## petalinux/project-spec/configs/configs/Kconfig.yoctomachinesettings
```kconfig
# Copyright (C) 2023, Advanced Micro Devices, Inc.  All rights reserved.
#
# SPDX-License-Identifier: MIT
#
#
config YOCTO_MACHINE_NAME
       string "Yocto Machine Name"
       default "versal-net-generic" if SUBSYSTEM_VARIANT_VERSALNET
       default "versal-generic" if SYSTEM_VERSAL
       default "versal-2ve-2vm-generic" if SYSTEM_VERSAL-2VE-2VM
       default "zynqmp-generic" if SYSTEM_ZYNQMP
       default "zynq-generic" if SUBSYSTEM_ARCH_ARM
       default "microblaze-generic" if SUBSYSTEM_ARCH_MICROBLAZE
       help
         You can specify MACHINE_NAME using this variable.
	 Auto append the deviceId to Machine Name if this matches with INCLUDE_MACHINE_NAME

config YOCTO_INCLUDE_MACHINE_NAME
	string "Yocto Include Machine name"
	default "ac701-microblazeel" if YOCTO_MACHINE_NAME = "xilinx-ac701"
	default "kc705-microblazeel" if YOCTO_MACHINE_NAME = "xilinx-kc705"
	default "kcu105-microblazeel" if YOCTO_MACHINE_NAME = "xilinx-kcu105"
	default "vcu118-microblazeel" if YOCTO_MACHINE_NAME = "xilinx-vcu118"
	default "kcu105-tmr-microblazeel" if YOCTO_MACHINE_NAME = "xilinx-sp701"
	default "zc702-zynq7" if YOCTO_MACHINE_NAME = "xilinx-zc702"
	default "zc706-zynq7" if YOCTO_MACHINE_NAME = "xilinx-zc706"
	default "zedboard-zynq7" if YOCTO_MACHINE_NAME = "avnet-digilent-zedboard"
	default "zc1751-zynqmp" if YOCTO_MACHINE_NAME = "xilinx-zc1751-dc1"
	default "zcu102-zynqmp" if YOCTO_MACHINE_NAME = "xilinx-zcu102"
	default "zcu104-zynqmp" if YOCTO_MACHINE_NAME = "xilinx-zcu104"
	default "zcu106-zynqmp" if YOCTO_MACHINE_NAME = "xilinx-zcu106"
	default "zcu111-zynqmp" if YOCTO_MACHINE_NAME = "xilinx-zcu111"
	default "zcu208-zynqmp" if YOCTO_MACHINE_NAME = "xilinx-zcu208"
	default "zcu216-zynqmp" if YOCTO_MACHINE_NAME = "xilinx-zcu216"
	default "zcu670-zynqmp" if YOCTO_MACHINE_NAME = "xilinx-zcu670"
	default "k26-sm" if YOCTO_MACHINE_NAME = "xilinx-k26-som"
	default "k24-sm" if YOCTO_MACHINE_NAME = "xilinx-k24-som"
	default "k26-smk-kr" if YOCTO_MACHINE_NAME = "xilinx-k26-kr"
	default "k26-smk-kv" if YOCTO_MACHINE_NAME = "xilinx-k26-kv"
	default "k24-smk-kd" if YOCTO_MACHINE_NAME = "xilinx-k24-kd"
	default "vck-sc-zynqmp" if YOCTO_MACHINE_NAME = "xilinx-vck190-sc"
	default "eval-brd-sc-zynqmp" if YOCTO_MACHINE_NAME = "eval-brd-sc"
	default "vck190-versal" if YOCTO_MACHINE_NAME = "xilinx-vck190"
	default "vc-p-a2197-00-versal" if YOCTO_MACHINE_NAME = "xilinx-vc-p-a2197-00"
	default "vck5000-versal" if YOCTO_MACHINE_NAME = "xilinx-vck5000"
	default "vek280-versal" if YOCTO_MACHINE_NAME = "xilinx-vek280"
	default "vhk158-versal" if YOCTO_MACHINE_NAME = "xilinx-vhk158"
	default "vmk180-versal" if YOCTO_MACHINE_NAME = "xilinx-vmk180"
	default "vpk120-versal" if YOCTO_MACHINE_NAME = "xilinx-vpk120"
	default "vpk180-versal" if YOCTO_MACHINE_NAME = "xilinx-vpk180"
	help
	  Specify MACHINE_NAME which will need to be include into the YOCTO_MACHINE file

config YOCTO_ADD_OVERRIDES
	string "Yocto Additional Overrides"
	default ""
	help
	  Specify additional overrides to the generated machine conf file
	  Specify multiple overrides with ':' separator

if SUBSYSTEM_SDT_FLOW

menu "Multiconfig Targets"
config YOCTO_BBMC_LINUX_DTSI
        string "DTSI path for linux (optional)"
        default ""
        
        help
         The specified files shall be directly merged into the domain DTS.
         Includes are applied in their listed order.

         Specify multiple files using space separation.

config YOCTO_BBMC_CORTEXA72_0_BAREMETAL
        bool "cortexa72-0-baremetal"
        default n

config YOCTO_BBMC_CORTEXA72_0_BAREMETAL_DTSI
        string "DTSI path for cortexa72-0-baremetal (optional)"
        default ""
        depends on YOCTO_BBMC_CORTEXA72_0_BAREMETAL
        help
         The specified files shall be directly merged into the domain DTS.
         Includes are applied in their listed order.

         Specify multiple files using space separation.

config YOCTO_BBMC_CORTEXA72_0_FREERTOS
        bool "cortexa72-0-freertos"
        default n

config YOCTO_BBMC_CORTEXA72_0_FREERTOS_DTSI
        string "DTSI path for cortexa72-0-freertos (optional)"
        default ""
        depends on YOCTO_BBMC_CORTEXA72_0_FREERTOS
        help
         The specified files shall be directly merged into the domain DTS.
         Includes are applied in their listed order.

         Specify multiple files using space separation.

config YOCTO_BBMC_CORTEXA72_1_BAREMETAL
        bool "cortexa72-1-baremetal"
        default n

config YOCTO_BBMC_CORTEXA72_1_BAREMETAL_DTSI
        string "DTSI path for cortexa72-1-baremetal (optional)"
        default ""
        depends on YOCTO_BBMC_CORTEXA72_1_BAREMETAL
        help
         The specified files shall be directly merged into the domain DTS.
         Includes are applied in their listed order.

         Specify multiple files using space separation.

config YOCTO_BBMC_CORTEXA72_1_FREERTOS
        bool "cortexa72-1-freertos"
        default n

config YOCTO_BBMC_CORTEXA72_1_FREERTOS_DTSI
        string "DTSI path for cortexa72-1-freertos (optional)"
        default ""
        depends on YOCTO_BBMC_CORTEXA72_1_FREERTOS
        help
         The specified files shall be directly merged into the domain DTS.
         Includes are applied in their listed order.

         Specify multiple files using space separation.

config YOCTO_BBMC_MICROBLAZE_PMC
        bool "microblaze-pmc"
        default y

config YOCTO_BBMC_MICROBLAZE_PMC_DTSI
        string "DTSI path for microblaze-pmc (optional)"
        default ""
        depends on YOCTO_BBMC_MICROBLAZE_PMC
        help
         The specified files shall be directly merged into the domain DTS.
         Includes are applied in their listed order.

         Specify multiple files using space separation.

config YOCTO_BBMC_MICROBLAZE_PSM
        bool "microblaze-psm"
        default y

config YOCTO_BBMC_MICROBLAZE_PSM_DTSI
        string "DTSI path for microblaze-psm (optional)"
        default ""
        depends on YOCTO_BBMC_MICROBLAZE_PSM
        help
         The specified files shall be directly merged into the domain DTS.
         Includes are applied in their listed order.

         Specify multiple files using space separation.

config YOCTO_BBMC_CORTEXR5_0_BAREMETAL
        bool "cortexr5-0-baremetal"
        default n

config YOCTO_BBMC_CORTEXR5_0_BAREMETAL_DTSI
        string "DTSI path for cortexr5-0-baremetal (optional)"
        default ""
        depends on YOCTO_BBMC_CORTEXR5_0_BAREMETAL
        help
         The specified files shall be directly merged into the domain DTS.
         Includes are applied in their listed order.

         Specify multiple files using space separation.

config YOCTO_BBMC_CORTEXR5_0_FREERTOS
        bool "cortexr5-0-freertos"
        default n

config YOCTO_BBMC_CORTEXR5_0_FREERTOS_DTSI
        string "DTSI path for cortexr5-0-freertos (optional)"
        default ""
        depends on YOCTO_BBMC_CORTEXR5_0_FREERTOS
        help
         The specified files shall be directly merged into the domain DTS.
         Includes are applied in their listed order.

         Specify multiple files using space separation.

config YOCTO_BBMC_CORTEXR5_1_BAREMETAL
        bool "cortexr5-1-baremetal"
        default n

config YOCTO_BBMC_CORTEXR5_1_BAREMETAL_DTSI
        string "DTSI path for cortexr5-1-baremetal (optional)"
        default ""
        depends on YOCTO_BBMC_CORTEXR5_1_BAREMETAL
        help
         The specified files shall be directly merged into the domain DTS.
         Includes are applied in their listed order.

         Specify multiple files using space separation.

config YOCTO_BBMC_CORTEXR5_1_FREERTOS
        bool "cortexr5-1-freertos"
        default n

config YOCTO_BBMC_CORTEXR5_1_FREERTOS_DTSI
        string "DTSI path for cortexr5-1-freertos (optional)"
        default ""
        depends on YOCTO_BBMC_CORTEXR5_1_FREERTOS
        help
         The specified files shall be directly merged into the domain DTS.
         Includes are applied in their listed order.

         Specify multiple files using space separation.
endmenu

config YOCTO_MC_DOMAIN_FILEPATH
	string "Domain file Path"
	default ""
	help
	  Specify the domain file path to use in the generation of multiconfig files.

endif
```
