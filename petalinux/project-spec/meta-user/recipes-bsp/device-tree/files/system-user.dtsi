/include/ "system-conf.dtsi"
/ {
};

/* zocl (/dev/dri): wire the 63 PL CU-completion IRQs to the two axi_intc
 * controllers (32 from axi_intc_cascaded_1 @a4040000 + 31 from axi_intc_parent
 * @a4050000, sense 4). Baked here so the petalinux-built dtb needs NO post-boot
 * patch for zocl to probe. Labels resolve from the SDT pl.dtsi. */
&amba {
        zyxclmm_drm {
                compatible = "xlnx,zocl-versal";
                interrupts-extended = <
                        &axi_intc_cascaded_1 0 4  &axi_intc_cascaded_1 1 4  &axi_intc_cascaded_1 2 4  &axi_intc_cascaded_1 3 4
                        &axi_intc_cascaded_1 4 4  &axi_intc_cascaded_1 5 4  &axi_intc_cascaded_1 6 4  &axi_intc_cascaded_1 7 4
                        &axi_intc_cascaded_1 8 4  &axi_intc_cascaded_1 9 4  &axi_intc_cascaded_1 10 4 &axi_intc_cascaded_1 11 4
                        &axi_intc_cascaded_1 12 4 &axi_intc_cascaded_1 13 4 &axi_intc_cascaded_1 14 4 &axi_intc_cascaded_1 15 4
                        &axi_intc_cascaded_1 16 4 &axi_intc_cascaded_1 17 4 &axi_intc_cascaded_1 18 4 &axi_intc_cascaded_1 19 4
                        &axi_intc_cascaded_1 20 4 &axi_intc_cascaded_1 21 4 &axi_intc_cascaded_1 22 4 &axi_intc_cascaded_1 23 4
                        &axi_intc_cascaded_1 24 4 &axi_intc_cascaded_1 25 4 &axi_intc_cascaded_1 26 4 &axi_intc_cascaded_1 27 4
                        &axi_intc_cascaded_1 28 4 &axi_intc_cascaded_1 29 4 &axi_intc_cascaded_1 30 4 &axi_intc_cascaded_1 31 4
                        &axi_intc_parent 0 4  &axi_intc_parent 1 4  &axi_intc_parent 2 4  &axi_intc_parent 3 4
                        &axi_intc_parent 4 4  &axi_intc_parent 5 4  &axi_intc_parent 6 4  &axi_intc_parent 7 4
                        &axi_intc_parent 8 4  &axi_intc_parent 9 4  &axi_intc_parent 10 4 &axi_intc_parent 11 4
                        &axi_intc_parent 12 4 &axi_intc_parent 13 4 &axi_intc_parent 14 4 &axi_intc_parent 15 4
                        &axi_intc_parent 16 4 &axi_intc_parent 17 4 &axi_intc_parent 18 4 &axi_intc_parent 19 4
                        &axi_intc_parent 20 4 &axi_intc_parent 21 4 &axi_intc_parent 22 4 &axi_intc_parent 23 4
                        &axi_intc_parent 24 4 &axi_intc_parent 25 4 &axi_intc_parent 26 4 &axi_intc_parent 27 4
                        &axi_intc_parent 28 4 &axi_intc_parent 29 4 &axi_intc_parent 30 4
                >;
        };
};
